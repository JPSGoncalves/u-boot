## drivers/phy/cadence/Kconfig
```kconfig
config PHY_CADENCE_SIERRA
	tristate "Cadence Sierra PHY Driver"
	depends on DM_RESET
	help
	  Enable this to support the Cadence Sierra PHY driver

config PHY_CADENCE_TORRENT
	tristate "Cadence Torrent PHY Driver"
	depends on DM_RESET
	help
	  Enable this to support the Cadence Torrent PHY driver

config PHY_CADENCE_NXP_SALVO
	tristate "Cadence NXP Salvo PHY Driver"
	help
	  Enable this to support the Cadence NXP SALVO PHY driver used on IMX8QM/X  devices.
```
